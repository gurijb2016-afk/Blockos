## Kconfig.drivers
```kconfig
menu "Device Drivers"

config DRIVERS
    bool "Device driver support"
    default y

if DRIVERS

config DRIVER_DEVICE_MANAGER
    bool "Device manager"
    default y

config DRIVER_DMA
    bool "DMA allocator"
    default y

config DRIVER_PCI
    bool "PCI / PCIe"
    default y
    depends on ARCH_X86_64

config DRIVER_ACPI
    bool "ACPI"
    default y
    depends on ARCH_X86_64

config DRIVER_ATA
    bool "ATA PIO storage"
    default y
    depends on ARCH_X86_64

config DRIVER_GRAPHICS_FB
    bool "Framebuffer"
    default y

config DRIVER_GRAPHICS_AMD_DCN6
    bool "AMD DCN6 display"
    default y
    depends on ARCH_X86_64

config DRIVER_PS2
    bool "PS/2 input"
    default y
    depends on ARCH_X86_64

config DRIVER_USB
    bool "USB subsystem"
    default y
    depends on ARCH_X86_64

config DRIVER_USB_XHCI
    bool "USB xHCI"
    default y
    depends on DRIVER_USB

config DRIVER_USB_HID
    bool "USB HID"
    default y
    depends on DRIVER_USB

config DRIVER_USB_STORAGE
    bool "USB storage"
    default y
    depends on DRIVER_USB

config DRIVER_VIRTIO
    bool "VirtIO core"
    default y
    depends on ARCH_X86_64

config DRIVER_VIRTIO_BLOCK
    bool "VirtIO block"
    default y
    depends on DRIVER_VIRTIO

config DRIVER_VIRTIO_NET
    bool "VirtIO network"
    default y
    depends on DRIVER_VIRTIO

config DRIVER_VIRTIO_RNG
    bool "VirtIO RNG (entropy)"
    default y
    depends on DRIVER_VIRTIO

config DRIVER_SERIAL
    bool "16550 UART serial driver"
    default y
    depends on ARCH_X86_64

config DRIVER_VIRTIO_INPUT
    bool "VirtIO input"
    default y
    depends on DRIVER_VIRTIO

config DRIVER_NETWORK
    bool "Network core"
    default y

config DRIVER_DHCP_DNS
    bool "DHCP / DNS stack"
    default y
    depends on DRIVER_NETWORK

config DRIVER_SOCKET
    bool "Kernel socket support"
    default y
    depends on DRIVER_NETWORK

config DRIVER_VM
    bool "Virtual memory device support"
    default y

endif

endmenu
```

## kconfig
```kconfig
mainmenu "BlockOS Configuration"

config BLOCKOS
    bool "BlockOS kernel"
    default y

menu "Architecture"

source "Kconfig.arch"

endmenu

menu "File systems"

source "Kconfig.fs"

endmenu

menu "Drivers"

source "Kconfig.drivers"

endmenu

menu "Networking"

source "Kconfig.network"

endmenu

menu "Graphics"

source "Kconfig.gui"

endmenu

menu "Applications"

source "Kconfig.apps"

endmenu
```

## scripts/kconfig
```kconfig
mainmenu "BlockOS Configuration"

source "Kconfig.arch"
source "Kconfig.kernel"
source "Kconfig.libc"
source "Kconfig.drivers"
source "Kconfig.fs"
source "Kconfig.network"
source "Kconfig.gui"
source "Kconfig.apps"
```

## scripts/kconfig.arch
```kconfig
choice
    prompt "Target architecture"
    default BLOCKOS_X86_64

config BLOCKOS_X86_64
    bool "x86_64"

config BLOCKOS_AARCH64
    bool "AArch64"

endchoice

config BLOCKOS_UEFI
    bool "UEFI boot support"
    default y
    depends on BLOCKOS_X86_64
```

## scripts/kconfig.drivers
```kconfig
menu "Device Drivers"

config DRIVERS
    bool "Device drivers"
    default y

if DRIVERS

config DRIVER_PCI
    bool "PCI"
    default y

config DRIVER_AHCI
    bool "AHCI"
    default y

config DRIVER_NVME
    bool "NVMe"
    default y

config DRIVER_VIRTIO
    bool "VirtIO"
    default y

config DRIVER_VIRTIO_NET
    bool "VirtIO network"
    depends on DRIVER_VIRTIO
    default y

config DRIVER_VIRTIO_GPU
    bool "VirtIO GPU"
    depends on DRIVER_VIRTIO
    default y

config DRIVER_PS2
    bool "PS/2"
    default y

config DRIVER_USB
    bool "USB"
    default y

config DRIVER_NVIDIA
    bool "NVIDIA"
    default n

endif

endmenu
```

## scripts/kconfig.libc
```kconfig
menu "C Library / libc"

config LIBC
    bool "Enable BlockOS libc"
    default y

config LIBC_STRING
    bool "String functions"
    default y
    depends on LIBC

config LIBC_MEMORY
    bool "Memory functions"
    default y
    depends on LIBC

config LIBC_STDIO
    bool "stdio"
    default y
    depends on LIBC

config LIBC_STDLIB
    bool "stdlib"
    default y
    depends on LIBC

config LIBC_CTYPE
    bool "ctype"
    default y
    depends on LIBC

config LIBC_TIME
    bool "Time functions"
    default y
    depends on LIBC

config LIBC_UNISTD
    bool "POSIX unistd"
    default y
    depends on LIBC

config LIBC_POSIX
    bool "POSIX compatibility"
    default y
    depends on LIBC

config LIBC_MATH
    bool "Math library"
    default y
    depends on LIBC

config LIBC_PTHREAD
    bool "pthread compatibility"
    default n
    depends on LIBC

config LIBC_DYNAMIC_ALLOC
    bool "Dynamic memory allocation"
    default y
    depends on LIBC

endmenu
```
